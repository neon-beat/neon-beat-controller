## Config.in
```kconfig
source "$BR2_EXTERNAL_NEON_BEAT_PATH/package/neon-beat-admin-frontend/Config.in"
source "$BR2_EXTERNAL_NEON_BEAT_PATH/package/neon-beat-backend/Config.in"
source "$BR2_EXTERNAL_NEON_BEAT_PATH/package/neon-beat-game-frontend/Config.in"
source "$BR2_EXTERNAL_NEON_BEAT_PATH/package/couchdb/Config.in"
```

## package/couchdb/Config.in
```kconfig
config BR2_PACKAGE_COUCHDB
	bool "couchdb"
	select BR2_PACKAGE_OPENSSL
	select BR2_PACKAGE_HOST_ERLANG # build time dependency
	select BR2_PACKAGE_ERLANG # build time dependency
	select BR2_PACKAGE_QUICKJS # run time dependency
	select BR2_PACKAGE_ICU
	
	help
		CouchDB is an open-source document-oriented NoSQL database,
		implemented in Erlang. This package does not really build
		CouchDB: it merely imports a docker an offline docker image on
		first boot. Please note that it implies that the package is
		not portable: it only works for ARMv8.

		https://hub.docker.com/r/arm64v8/couchdb
```

## package/neon-beat-admin-frontend/Config.in
```kconfig
config BR2_PACKAGE_NEON_BEAT_ADMIN_FRONTEND
	bool "neon-beat-admin-frontend"
	select BR2_PACKAGE_HOST_NODEJS
	select BR2_PACKAGE_LIGHTTPD
	help
	  The Neon Beat admin frontend is the game master interface. It
	  allows to control a Neon Beat game: reveal songs, manipulate
	  scores, play/pause, configure a new game, etc.

	  https://github.com/neon-beat/neon-beat-admin-front
```

## package/neon-beat-backend/Config.in
```kconfig
config BR2_PACKAGE_NEON_BEAT_BACKEND
	bool "neon-beat-backend"
	depends on BR2_PACKAGE_HOST_RUSTC_TARGET_ARCH_SUPPORTS
	select BR2_PACKAGE_HOST_RUSTC
	help
	  The Neon Beat backend is the main software controller for Neon Beat.
	  It is in charge of monitoring the buzzers, handling the game state,
	  expose controls to the game admin, etc
	
	  https://github.com/neon-beat/neon-beat-back
```

## package/neon-beat-frontend/Config.in
```kconfig
config BR2_PACKAGE_NEON_BEAT_FRONTEND
	bool "neon-beat-frontend"
	select BR2_PACKAGE_HOST_NODEJS
	select BR2_PACKAGE_LIGHTTPD
	help
	  The Neon Beat frontend is the user-visible interface when playing a
	  Neon Beat game. It allows to play a song, reveal the song, manage
	  scores, etc

	  https://github.com/neon-beat/neon-beat-game-front
```

## package/neon-beat-game-frontend/Config.in
```kconfig
config BR2_PACKAGE_NEON_BEAT_GAME_FRONTEND
	bool "neon-beat-game-frontend"
	select BR2_PACKAGE_HOST_NODEJS
	select BR2_PACKAGE_LIGHTTPD
	help
	  The Neon Beat game frontend is the user-visible interface when
	  playing a Neon Beat game. It is in charge of displaying the song
	  countdown, the teams, scores, etc

	  https://github.com/neon-beat/neon-beat-game-front
```
